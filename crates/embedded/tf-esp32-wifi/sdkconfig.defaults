## crates/embedded/tf-esp32-wifi/sdkconfig.defaults
```kconfig
# Defaults for the ESP-IDF menuconfig surface so a fresh checkout
# builds cleanly without an interactive prompt.

# WiFi station mode — STA only, no AP, no SoftAP.
CONFIG_ESP32_WIFI_STATIC_RX_BUFFER_NUM=10
CONFIG_ESP32_WIFI_DYNAMIC_RX_BUFFER_NUM=32
CONFIG_ESP32_WIFI_TX_BUFFER=DYNAMIC

# Larger main task stack — TrustForge sign + JSON encode + TLS
# handshake doesn't fit in 3.5 KiB.
CONFIG_ESP_MAIN_TASK_STACK_SIZE=10240

# Enable mbedTLS — the HTTP client uses it for HTTPS uplink.
CONFIG_MBEDTLS_HARDWARE_AES=y
CONFIG_MBEDTLS_HARDWARE_SHA=y

# Logging: INFO by default, hosts can drop to DEBUG via menuconfig.
CONFIG_LOG_DEFAULT_LEVEL_INFO=y
```

## tools/native/openwrt/Config.in
```kconfig
# Build-time menu options exposed under
#   Utilities  --->  trustforge  --->  Configuration
#
# These flip features on at install time. Runtime behaviour is still
# controlled by /etc/config/trustforge (UCI).

menu "Configuration"
	depends on PACKAGE_trustforge

config TRUSTFORGE_ENABLE_TLS
	bool "Enable TLS bridge (--enable-tls)"
	default y
	help
	  Enables the TLS / X.509 compatibility bridge so that existing
	  HTTPS clients can authenticate against the TrustForge actor
	  registry. Disable on RAM-constrained targets.

config TRUSTFORGE_ENABLE_RELAY
	bool "Enable relay role (--enable-relay)"
	default n
	help
	  Allow this device to forward TrustForge packets on behalf of
	  other actors. Forwarding authority is separate from action
	  authority; the relay cannot decrypt or execute payloads.

config TRUSTFORGE_ENABLE_DASHBOARD
	bool "Enable embedded dashboard (--enable-dashboard)"
	default n
	help
	  Serves the lightweight tf-dashboard on the loopback interface.
	  When the LuCI app is installed, prefer that and leave this off.

endmenu
```
